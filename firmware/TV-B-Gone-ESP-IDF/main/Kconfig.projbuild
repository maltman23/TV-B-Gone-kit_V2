## firmware/TV-B-Gone-ESP-IDF/main/Kconfig.projbuild
```kconfig
menu "TV-B-Gone Configuration"

config TVBGONE_VISLED_GPIO
    int "Visible LED GPIO"
    range 0 21
    default 8
    help
        GPIO used for the visible status LED.

config TVBGONE_IRLED_GPIO
    int "IR LED GPIO"
    range 0 21
    default 2
    help
        GPIO used for the IR transmitter output.

config TVBGONE_BUTTON_NA_GPIO
    int "NA button GPIO"
    range 0 21
    default 10
    help
        GPIO connected to the North America region select button.

config TVBGONE_BUTTON_EU_GPIO
    int "EU button GPIO"
    range 0 21
    default 9
    help
        GPIO connected to the Europe region select button.

endmenu
```
